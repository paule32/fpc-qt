SEARCH_DIR("E:\FPCdeluxe\cross\lib\x86_64-linux\")
SEARCH_DIR(".\Linux64\Release\")
SEARCH_DIR("E:\FPCdeluxe\fpc\units\x86_64-linux\")
SEARCH_DIR(".\pas\")
SEARCH_DIR(".\")
SEARCH_DIR("E:\FPCdeluxe\fpc\units\x86_64-linux\httpd22\")
SEARCH_DIR("E:\FPCdeluxe\fpc\units\x86_64-linux\rtl\")
SEARCH_DIR("E:\FPCdeluxe\fpc\units\x86_64-linux\zorba\")
SEARCH_DIR("E:\FPCdeluxe\fpc\units\x86_64-linux\zlib\")
SEARCH_DIR("E:\FPCdeluxe\fpc\units\x86_64-linux\xforms\")
SEARCH_DIR("E:\FPCdeluxe\fpc\units\x86_64-linux\x11\")
SEARCH_DIR("E:\FPCdeluxe\fpc\units\x86_64-linux\webidl\")
SEARCH_DIR("E:\FPCdeluxe\fpc\units\x86_64-linux\vcl-compat\")
SEARCH_DIR("E:\FPCdeluxe\fpc\units\x86_64-linux\uuid\")
SEARCH_DIR("E:\FPCdeluxe\fpc\units\x86_64-linux\utmp\")
SEARCH_DIR("E:\FPCdeluxe\fpc\units\x86_64-linux\users\")
SEARCH_DIR("E:\FPCdeluxe\fpc\units\x86_64-linux\unzip\")
SEARCH_DIR("E:\FPCdeluxe\fpc\units\x86_64-linux\tplylib\")
SEARCH_DIR("E:\FPCdeluxe\fpc\units\x86_64-linux\tcl\")
SEARCH_DIR("E:\FPCdeluxe\fpc\units\x86_64-linux\syslog\")
SEARCH_DIR("E:\FPCdeluxe\fpc\units\x86_64-linux\symbolic\")
SEARCH_DIR("E:\FPCdeluxe\fpc\units\x86_64-linux\svgalib\")
SEARCH_DIR("E:\FPCdeluxe\fpc\units\x86_64-linux\sqlite\")
SEARCH_DIR("E:\FPCdeluxe\fpc\units\x86_64-linux\sdl\")
SEARCH_DIR("E:\FPCdeluxe\fpc\units\x86_64-linux\rtl-unicode\")
SEARCH_DIR("E:\FPCdeluxe\fpc\units\x86_64-linux\rtl-objpas\")
SEARCH_DIR("E:\FPCdeluxe\fpc\units\x86_64-linux\rtl-generics\")
SEARCH_DIR("E:\FPCdeluxe\fpc\units\x86_64-linux\rtl-extra\")
SEARCH_DIR("E:\FPCdeluxe\fpc\units\x86_64-linux\rtl-console\")
SEARCH_DIR("E:\FPCdeluxe\fpc\units\x86_64-linux\rsvg\")
SEARCH_DIR("E:\FPCdeluxe\fpc\units\x86_64-linux\regexpr\")
SEARCH_DIR("E:\FPCdeluxe\fpc\units\x86_64-linux\pxlib\")
SEARCH_DIR("E:\FPCdeluxe\fpc\units\x86_64-linux\pthreads\")
SEARCH_DIR("E:\FPCdeluxe\fpc\units\x86_64-linux\ptc\")
SEARCH_DIR("E:\FPCdeluxe\fpc\units\x86_64-linux\proj4\")
SEARCH_DIR("E:\FPCdeluxe\fpc\units\x86_64-linux\postgres\")
SEARCH_DIR("E:\FPCdeluxe\fpc\units\x86_64-linux\pcap\")
SEARCH_DIR("E:\FPCdeluxe\fpc\units\x86_64-linux\paszlib\")
SEARCH_DIR("E:\FPCdeluxe\fpc\units\x86_64-linux\pastojs\")
SEARCH_DIR("E:\FPCdeluxe\fpc\units\x86_64-linux\pasjpeg\")
SEARCH_DIR("E:\FPCdeluxe\fpc\units\x86_64-linux\oracle\")
SEARCH_DIR("E:\FPCdeluxe\fpc\units\x86_64-linux\openssl\")
SEARCH_DIR("E:\FPCdeluxe\fpc\units\x86_64-linux\opengles\")
SEARCH_DIR("E:\FPCdeluxe\fpc\units\x86_64-linux\opengl\")
SEARCH_DIR("E:\FPCdeluxe\fpc\units\x86_64-linux\opencl\")
SEARCH_DIR("E:\FPCdeluxe\fpc\units\x86_64-linux\openal\")
SEARCH_DIR("E:\FPCdeluxe\fpc\units\x86_64-linux\oggvorbis\")
SEARCH_DIR("E:\FPCdeluxe\fpc\units\x86_64-linux\odbc\")
SEARCH_DIR("E:\FPCdeluxe\fpc\units\x86_64-linux\odata\")
SEARCH_DIR("E:\FPCdeluxe\fpc\units\x86_64-linux\numlib\")
SEARCH_DIR("E:\FPCdeluxe\fpc\units\x86_64-linux\newt\")
SEARCH_DIR("E:\FPCdeluxe\fpc\units\x86_64-linux\ncurses\")
SEARCH_DIR("E:\FPCdeluxe\fpc\units\x86_64-linux\mysql\")
SEARCH_DIR("E:\FPCdeluxe\fpc\units\x86_64-linux\modplug\")
SEARCH_DIR("E:\FPCdeluxe\fpc\units\x86_64-linux\mad\")
SEARCH_DIR("E:\FPCdeluxe\fpc\units\x86_64-linux\lua\")
SEARCH_DIR("E:\FPCdeluxe\fpc\units\x86_64-linux\libxml2\")
SEARCH_DIR("E:\FPCdeluxe\fpc\units\x86_64-linux\libvlc\")
SEARCH_DIR("E:\FPCdeluxe\fpc\units\x86_64-linux\libusb\")
SEARCH_DIR("E:\FPCdeluxe\fpc\units\x86_64-linux\libtar\")
SEARCH_DIR("E:\FPCdeluxe\fpc\units\x86_64-linux\libsee\")
SEARCH_DIR("E:\FPCdeluxe\fpc\units\x86_64-linux\libpng\")
SEARCH_DIR("E:\FPCdeluxe\fpc\units\x86_64-linux\libmicrohttpd\")
SEARCH_DIR("E:\FPCdeluxe\fpc\units\x86_64-linux\libmagic\")
SEARCH_DIR("E:\FPCdeluxe\fpc\units\x86_64-linux\libgd\")
SEARCH_DIR("E:\FPCdeluxe\fpc\units\x86_64-linux\libgc\")
SEARCH_DIR("E:\FPCdeluxe\fpc\units\x86_64-linux\libfontconfig\")
SEARCH_DIR("E:\FPCdeluxe\fpc\units\x86_64-linux\libffi\")
SEARCH_DIR("E:\FPCdeluxe\fpc\units\x86_64-linux\libenet\")
SEARCH_DIR("E:\FPCdeluxe\fpc\units\x86_64-linux\libcurl\")
SEARCH_DIR("E:\FPCdeluxe\fpc\units\x86_64-linux\libcups\")
SEARCH_DIR("E:\FPCdeluxe\fpc\units\x86_64-linux\ldap\")
SEARCH_DIR("E:\FPCdeluxe\fpc\units\x86_64-linux\jni\")
SEARCH_DIR("E:\FPCdeluxe\fpc\units\x86_64-linux\imlib\")
SEARCH_DIR("E:\FPCdeluxe\fpc\units\x86_64-linux\imagemagick\")
SEARCH_DIR("E:\FPCdeluxe\fpc\units\x86_64-linux\iconvenc\")
SEARCH_DIR("E:\FPCdeluxe\fpc\units\x86_64-linux\ibase\")
SEARCH_DIR("E:\FPCdeluxe\fpc\units\x86_64-linux\httpd24\")
SEARCH_DIR("E:\FPCdeluxe\fpc\units\x86_64-linux\hermes\")
SEARCH_DIR("E:\FPCdeluxe\fpc\units\x86_64-linux\hash\")
SEARCH_DIR("E:\FPCdeluxe\fpc\units\x86_64-linux\gtk2\")
SEARCH_DIR("E:\FPCdeluxe\fpc\units\x86_64-linux\gtk1\")
SEARCH_DIR("E:\FPCdeluxe\fpc\units\x86_64-linux\graph\")
SEARCH_DIR("E:\FPCdeluxe\fpc\units\x86_64-linux\googleapi\")
SEARCH_DIR("E:\FPCdeluxe\fpc\units\x86_64-linux\gnutls\")
SEARCH_DIR("E:\FPCdeluxe\fpc\units\x86_64-linux\gnome1\")
SEARCH_DIR("E:\FPCdeluxe\fpc\units\x86_64-linux\gmp\")
SEARCH_DIR("E:\FPCdeluxe\fpc\units\x86_64-linux\ggi\")
SEARCH_DIR("E:\FPCdeluxe\fpc\units\x86_64-linux\gdbm\")
SEARCH_DIR("E:\FPCdeluxe\fpc\units\x86_64-linux\gdbint\")
SEARCH_DIR("E:\FPCdeluxe\fpc\units\x86_64-linux\fv\")
SEARCH_DIR("E:\FPCdeluxe\fpc\units\x86_64-linux\fppkg\")
SEARCH_DIR("E:\FPCdeluxe\fpc\units\x86_64-linux\fpmkunit\")
SEARCH_DIR("E:\FPCdeluxe\fpc\units\x86_64-linux\fpindexer\")
SEARCH_DIR("E:\FPCdeluxe\fpc\units\x86_64-linux\fpgtk\")
SEARCH_DIR("E:\FPCdeluxe\fpc\units\x86_64-linux\fftw\")
SEARCH_DIR("E:\FPCdeluxe\fpc\units\x86_64-linux\fcl-xml\")
SEARCH_DIR("E:\FPCdeluxe\fpc\units\x86_64-linux\fcl-web\")
SEARCH_DIR("E:\FPCdeluxe\fpc\units\x86_64-linux\fcl-stl\")
SEARCH_DIR("E:\FPCdeluxe\fpc\units\x86_64-linux\fcl-sound\")
SEARCH_DIR("E:\FPCdeluxe\fpc\units\x86_64-linux\fcl-sdo\")
SEARCH_DIR("E:\FPCdeluxe\fpc\units\x86_64-linux\fcl-res\")
SEARCH_DIR("E:\FPCdeluxe\fpc\units\x86_64-linux\fcl-report\")
SEARCH_DIR("E:\FPCdeluxe\fpc\units\x86_64-linux\fcl-registry\")
SEARCH_DIR("E:\FPCdeluxe\fpc\units\x86_64-linux\fcl-process\")
SEARCH_DIR("E:\FPCdeluxe\fpc\units\x86_64-linux\fcl-pdf\")
SEARCH_DIR("E:\FPCdeluxe\fpc\units\x86_64-linux\fcl-passrc\")
SEARCH_DIR("E:\FPCdeluxe\fpc\units\x86_64-linux\fcl-net\")
SEARCH_DIR("E:\FPCdeluxe\fpc\units\x86_64-linux\fcl-json\")
SEARCH_DIR("E:\FPCdeluxe\fpc\units\x86_64-linux\fcl-js\")
SEARCH_DIR("E:\FPCdeluxe\fpc\units\x86_64-linux\fcl-image\")
SEARCH_DIR("E:\FPCdeluxe\fpc\units\x86_64-linux\fcl-fpcunit\")
SEARCH_DIR("E:\FPCdeluxe\fpc\units\x86_64-linux\fcl-extra\")
SEARCH_DIR("E:\FPCdeluxe\fpc\units\x86_64-linux\fcl-db\")
SEARCH_DIR("E:\FPCdeluxe\fpc\units\x86_64-linux\fcl-base\")
SEARCH_DIR("E:\FPCdeluxe\fpc\units\x86_64-linux\fcl-async\")
SEARCH_DIR("E:\FPCdeluxe\fpc\units\x86_64-linux\fastcgi\")
SEARCH_DIR("E:\FPCdeluxe\fpc\units\x86_64-linux\dts\")
SEARCH_DIR("E:\FPCdeluxe\fpc\units\x86_64-linux\dbus\")
SEARCH_DIR("E:\FPCdeluxe\fpc\units\x86_64-linux\dblib\")
SEARCH_DIR("E:\FPCdeluxe\fpc\units\x86_64-linux\chm\")
SEARCH_DIR("E:\FPCdeluxe\fpc\units\x86_64-linux\cdrom\")
SEARCH_DIR("E:\FPCdeluxe\fpc\units\x86_64-linux\cairo\")
SEARCH_DIR("E:\FPCdeluxe\fpc\units\x86_64-linux\bzip2\")
SEARCH_DIR("E:\FPCdeluxe\fpc\units\x86_64-linux\bfd\")
SEARCH_DIR("E:\FPCdeluxe\fpc\units\x86_64-linux\aspell\")
SEARCH_DIR("E:\FPCdeluxe\fpc\units\x86_64-linux\a52\")
SEARCH_DIR("E:\FPCdeluxe\fpc\bin\i386-win32\")
INPUT(
E:\FPCdeluxe\cross\lib\x86_64-linux\crti.o
E:\FPCdeluxe\cross\lib\x86_64-linux\crtbegin.o
E:\FPCdeluxe\fpc\units\x86_64-linux\rtl\si_c.o
E:\FPCdeluxe\fpc\units\x86_64-linux\rtl\abitag.o
E:\FPCdeluxe\fpc\units\x86_64-linux\rtl\system.o
E:\FPCdeluxe\fpc\units\x86_64-linux\rtl\objpas.o
E:\FPCdeluxe\fpc\units\x86_64-linux\rtl\classes.o
E:\FPCdeluxe\fpc\units\x86_64-linux\rtl\sysutils.o
E:\FPCdeluxe\fpc\units\x86_64-linux\fcl-base\inifiles.o
E:\FPCdeluxe\fpc\units\x86_64-linux\rtl\types.o
E:\FPCdeluxe\fpc\units\x86_64-linux\rtl\typinfo.o
E:\FPCdeluxe\fpc\units\x86_64-linux\rtl\rtlconsts.o
E:\FPCdeluxe\fpc\units\x86_64-linux\rtl\linux.o
E:\FPCdeluxe\fpc\units\x86_64-linux\rtl\unix.o
E:\FPCdeluxe\fpc\units\x86_64-linux\rtl\errors.o
E:\FPCdeluxe\fpc\units\x86_64-linux\rtl\sysconst.o
E:\FPCdeluxe\fpc\units\x86_64-linux\rtl\unixtype.o
E:\FPCdeluxe\fpc\units\x86_64-linux\rtl\baseunix.o
E:\FPCdeluxe\fpc\units\x86_64-linux\rtl\unixutil.o
E:\FPCdeluxe\fpc\units\x86_64-linux\rtl\math.o
E:\FPCdeluxe\fpc\units\x86_64-linux\fcl-base\contnrs.o
E:\FPCdeluxe\fpc\units\x86_64-linux\rtl\dynlibs.o
E:\FPCdeluxe\fpc\units\x86_64-linux\rtl\dl.o
E:\FPCdeluxe\fpc\units\x86_64-linux\rtl\ctypes.o
)
INPUT(
-ldl
)
GROUP(
-lc
)
INPUT(
E:\FPCdeluxe\cross\lib\x86_64-linux\crtend.o
E:\FPCdeluxe\cross\lib\x86_64-linux\crtn.o
)
SECTIONS
{
  .fpcdata           :
  {
    KEEP (*(.fpc .fpc.n_version .fpc.n_links))
  }
  .threadvar : { *(.threadvar .threadvar.* .gnu.linkonce.tv.*) }
}
INSERT AFTER .data;
